## fs/bcachefs/Kconfig
```kconfig
config BCACHEFS_FS
	tristate "bcachefs filesystem support"
	depends on BLOCK
	select EXPORTFS
	select CLOSURES
	select LIBCRC32C
	select CRC64
	select FS_POSIX_ACL
	select LZ4_COMPRESS
	select LZ4_DECOMPRESS
	select ZLIB_DEFLATE
	select ZLIB_INFLATE
	select ZSTD_COMPRESS
	select ZSTD_DECOMPRESS
	select CRYPTO_SHA256
	select CRYPTO_CHACHA20
	select CRYPTO_POLY1305
	select KEYS
	select SIXLOCKS
	select RAID6_PQ
	select XOR_BLOCKS
	select SRCU
	help
	The bcachefs filesystem - a modern, copy on write filesystem, with
	support for multiple devices, compression, checksumming, etc.

config BCACHEFS_QUOTA
	bool "bcachefs quota support"
	depends on BCACHEFS_FS
	select QUOTACTL

config BCACHEFS_POSIX_ACL
	bool "bcachefs POSIX ACL support"
	depends on BCACHEFS_FS
	select FS_POSIX_ACL

config BCACHEFS_ADDITIONAL_HASHES
	bool "bcachefs additional checksum / hashing support"
	depends on BCACHEFS_FS
	default n
	select XXHASH
	help
	Bcachefs has support for various data/metadata checksums to provide integrity.
	Select this option to include a number of additional algorithms which may be faster (or not) compared to default crc32/64.
	Supported algorithms:
		- xxhash (64-bit version only)

config BCACHEFS_DEBUG
	bool "bcachefs debugging"
	depends on BCACHEFS_FS
	help
	Enables many extra debugging checks and assertions.

	The resulting code will be significantly slower than normal; you
	probably shouldn't select this option unless you're a developer.

config BCACHEFS_TESTS
	bool "bcachefs unit and performance tests"
	depends on BCACHEFS_FS
	help
	Include some unit and performance tests for the core btree code
```
